## platform/esp32/sdkconfig.defaults
```kconfig
CONFIG_IDF_TARGET="esp32s3"
CONFIG_ESPTOOLPY_FLASHSIZE_16MB=y
CONFIG_PARTITION_TABLE_CUSTOM=y
CONFIG_PARTITION_TABLE_CUSTOM_FILENAME="partitions.csv"
CONFIG_COMPILER_OPTIMIZATION_PERF=y
CONFIG_ESP_DEFAULT_CPU_FREQ_MHZ_240=y
CONFIG_SPIRAM=y
CONFIG_SPIRAM_MODE_OCT=y
CONFIG_SPIRAM_SPEED_80M=y
CONFIG_FREERTOS_HZ=1000
CONFIG_FREERTOS_USE_TICKLESS_IDLE=y
CONFIG_PM_ENABLE=y
CONFIG_PM_SLP_IRAM_OPT=y
CONFIG_PM_RTOS_IDLE_OPT=y
CONFIG_LV_OS_FREERTOS=y
# CONFIG_LV_ATTRIBUTE_FAST_MEM_USE_IRAM is not set
CONFIG_LV_FONT_MONTSERRAT_12=y
CONFIG_LV_FONT_MONTSERRAT_16=y
CONFIG_LV_FONT_MONTSERRAT_20=y
CONFIG_LV_FONT_MONTSERRAT_24=y
CONFIG_LV_TXT_BREAK_CHARS=" ,.;:-_"
CONFIG_LV_USE_FS_STDIO=y
CONFIG_LV_FS_STDIO_LETTER=65
CONFIG_LV_FS_STDIO_PATH="/spiffs"
CONFIG_LV_USE_LODEPNG=y
CONFIG_LV_USE_CLIB_MALLOC=y
CONFIG_LV_CACHE_DEF_SIZE=0
CONFIG_LV_DEF_REFR_PERIOD=16
# USB: logs go to USB-Serial/JTAG on normal boot; TinyUSB CDC + MSC takes over
# the USB PHY only when BOOT is held at power-on (config drive mode).
CONFIG_USJ_ENABLE_USB_SERIAL_JTAG=y
CONFIG_USJ_NO_AUTO_LS_ON_CONNECTION=y
CONFIG_ESP_CONSOLE_SECONDARY_USB_SERIAL_JTAG=y
CONFIG_TINYUSB_CDC_ENABLED=y
CONFIG_TINYUSB_MSC_ENABLED=y
CONFIG_TINYUSB_DESC_MANUFACTURER_STRING="Tomato32"
CONFIG_TINYUSB_DESC_PRODUCT_STRING="Tomato32"
CONFIG_TINYUSB_DESC_CDC_STRING="Serial"
CONFIG_TINYUSB_DESC_MSC_STRING="Config Drive"
# FatFS / wear levelling for the config partition
CONFIG_WL_SECTOR_SIZE_512=y
CONFIG_FATFS_LFN_HEAP=y
```
